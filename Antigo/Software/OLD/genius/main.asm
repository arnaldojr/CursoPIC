#INCLUDE <P16F877A.INC>		;ARQUIVO PADRÃO MICROCHIP PARA 16F628A
	__CONFIG  _BODEN_ON & _CP_OFF & _PWRTE_ON & _WDT_OFF & _LVP_OFF & _XT_OSC

FILTRO_BTS  EQU .255
FILTRO_BTS4 EQU .250

; CONSTANTES
#DEFINE	BANK0	  BCF STATUS,RP0	;SETA BANK 0 DE MEMÓRIA
#DEFINE	BANK1	  BSF STATUS,RP0	;SETA BANK 1 DE MAMÓRIA
#DEFINE BANK_LOW  BCF STATUS,RP1    ; BANK0-1
#DEFINE BANK_HIGH BSF STATUS,RP1    ; BANK2-3
#DEFINE BT0       PORTB,0
#DEFINE BT1       PORTB,1 
#DEFINE BT2       PORTB,2
#DEFINE BT3       PORTB,3
#DEFINE LAMP      PORTA,0
#DEFINE DISPLAY   PORTD
#DEFINE BUZZER    PORTA,5
#DEFINE DEZENA    PORTB,7
#DEFINE UNIDADE   PORTB,6

CBLOCK 0x20
	FILTRO_BT0
	FILTRO_BT1
	FILTRO_BT2
	FILTRO_BT3
	STATUS_BTS
	STATUS_TEMP
	W_TEMP

	ESTADO ;0x27
	MULT1
	MULT2
	CONT1
	CONT2
	CONTIMER
	PROX_POS
	ACERTOS
	CONTBUZZER
	CONTLED
	CONT_UD
	ACERTOS2
	DELAY
	DELAY2 ; TEMPO ACESSO DISPLAY
	DELAY3 ; TEMPO APAGADO DISPLAY
ENDC 

ORG 0x00
	GOTO INICIO

ORG 0x04
	GOTO INTERUP

ORG 0x06
TABELA_DISPLAY_7_SEG
	ANDLW B'00001111' ; EXECUTA MASCARA P/ EVITAR PULOS ERRADOS
	ADDWF PCL,F ; SOMA DESLOCAMENTO AO PROGRAM COUNTER,
	; GERANDO UMA TABELA DO TIPO "CASE".
	; PGFEDCBA ; POSIÇÃO RELATIVA AOS SEGMENTOS
	RETLW	B'00111111'	; 00 - RETORNA SÍMBOLO CORRETO 0
	RETLW	B'00000110'	; 01 - RETORNA SÍMBOLO CORRETO 1
	RETLW	B'01011011'	; 02 - RETORNA SÍMBOLO CORRETO 2
	RETLW	B'01001111'	; 03 - RETORNA SÍMBOLO CORRETO 3
	RETLW	B'01100110'	; 04 - RETORNA SÍMBOLO CORRETO 4	
	RETLW	B'01101101'	; 05 - RETORNA SÍMBOLO CORRETO 5	
	RETLW	B'01111101'	; 06 - RETORNA SÍMBOLO CORRETO 6	
	RETLW	B'00000111'	; 07 - RETORNA SÍMBOLO CORRETO 7	
	RETLW	B'01111111'	; 08 - RETORNA SÍMBOLO CORRETO 8	
	RETLW	B'01101111'	; 09 - RETORNA SÍMBOLO CORRETO 9
	RETLW   B'00000000' ; LETRA A
	RETLW B'00000000' ; BH - BLANK
	RETLW B'00000000' ; CH - BLANK
	RETLW B'00000000' ; DH - BLANK
	RETLW B'00000000' ; EH - BLANK
	RETLW B'00000000' ; FH - BLANK
	; --------------------

TABELA_LED
	ANDLW B'00000111' ; EXECUTA MASCARA P/ EVITAR PULOS ERRADOS
	ADDWF PCL,F ; SOMA DESLOCAMENTO AO PROGRAM COUNTER,
	RETLW	B'10001111'	; 00 - ERRO
	RETLW	B'10000001'	; 01 - RETORNA SÍMBOLO CORRETO 1
	RETLW	B'10000010'	; 02 - RETORNA SÍMBOLO CORRETO 2
	RETLW	B'10000100'	; 03 - RETORNA SÍMBOLO CORRETO 3
	RETLW	B'10001000'	; 04 - RETORNA SÍMBOLO CORRETO 4	
	RETLW	B'10001111'	; 05 - ERRO
	RETLW	B'10001111'	; 06 - ERRO
	RETLW	B'10001111'	; 07 - ERRO
	; --------------------

RESET_TIMER
	MOVLW .6
	MOVWF TMR0
	BCF INTCON, TMR0IF
	RETURN

AJUSTA_PROX 
	MOVLW .1
	MOVWF PROX_POS
	RETURN

ESTADO_0
	MOVLW B'01000000'
	MOVWF DISPLAY
	GOTO SAI_INTERUP

LED_ACENDE
	MOVF INDF, W
	CALL TABELA_LED
	MOVWF PORTB
	GOTO SAI_INTERUP

LED_APAGA
	MOVLW B'10000000'
	MOVWF PORTB
	GOTO SAI_INTERUP
	
ESTADO_1
	;LED ACESO
	;VERIFICA SE JA ESTA EM ZERO
	MOVF CONT2, F
	BTFSC STATUS, Z
	GOTO  ESTADO_1_1

	; SE NAO ESTIVER DECREMENTA, AGUARDA COM LED APAGADO
	DECFSZ CONT2, F
	GOTO LED_APAGA
	
	; ACENDE O LED AQUI
ESTADO_1_1	
	MOVLW .0
	MOVWF DISPLAY
	DECFSZ CONT1, F
	GOTO LED_ACENDE

	MOVLW 0xA0
	ADDWF ACERTOS, W
	XORWF FSR, W
	BTFSC STATUS, Z
	GOTO SETA_ESTADO_2
	
	INCF FSR, F
	MOVF MULT1, W
	MOVWF CONT1
	MOVF MULT2, W
	MOVWF CONT2
	GOTO SAI_INTERUP	

SETA_ESTADO_2
	CALL AJUSTA_ENTRADA
	MOVLW 0xA0
	MOVWF FSR
	MOVLW .2
	MOVWF ESTADO
	BSF BUZZER
	MOVLW .25
	MOVWF CONTBUZZER
	MOVLW .25
	MOVWF CONTLED
	GOTO SAI_INTERUP

ESTADO_2
	; BUZZER
	MOVF CONTBUZZER, F
	BTFSC STATUS, Z
	GOTO ESTADO_2_1
	
	DECFSZ CONTBUZZER, F
	GOTO ESTADO_2_1
	
	BCF BUZZER
ESTADO_2_1
	MOVF CONTLED, F
	BTFSC STATUS, Z
	GOTO SAI_INTERUP
	
	DECFSZ CONTLED, F
	GOTO SAI_INTERUP
	
	MOVLW .0
	MOVWF DISPLAY
	MOVLW .25
	MOVWF CONTLED
	GOTO SAI_INTERUP

APAGA_DISPLAY
	MOVLW .0
	MOVWF DISPLAY
	GOTO SAI_INTERUP_3

ESTADO_3
	MOVF DELAY2, F
	BTFSC STATUS, Z
	GOTO  ESTADO_3_1

	DECFSZ DELAY2, F
	GOTO APAGA_DISPLAY
	
ESTADO_3_1	
	DECFSZ DELAY3, F
	GOTO   ACENDE_DISPLAY
	
	MOVLW .100
	MOVWF DELAY2
	MOVLW .50
	MOVWF DELAY3

ACENDE_DISPLAY	
	INCF CONT_UD, F ; PAR/IMPAR
	
	; APAGA O DISPLAY
	BCF DEZENA
	BCF UNIDADE
	MOVLW .0
	MOVWF DISPLAY
	
	BTFSC CONT_UD,0
	BSF  DEZENA
	BTFSS CONT_UD, 0
	BSF  UNIDADE

	MOVF ACERTOS2,W
	BTFSC CONT_UD, 0
	SWAPF ACERTOS2, W ; ISOLA A DEZENA
	ANDLW 0x0F       ; ISOLA A DEZENA
	
	CALL TABELA_DISPLAY_7_SEG
	MOVWF DISPLAY
	GOTO SAI_INTERUP_3

INTERUP
	; SALVA WORK/FLAGS DE TRABALHO
	MOVWF W_TEMP
	SWAPF STATUS, W
	CLRF STATUS
	MOVWF STATUS_TEMP

	; RANDOM DE 1 A 4 PARA PROXIMA POS
	INCF PROX_POS,F
	MOVLW .5
	XORWF PROX_POS, W
	BTFSC STATUS, Z
	CALL AJUSTA_PROX	

	; MOSTRA PONTUACAO (FORA DO DIVISOR DE 10x)
	MOVLW .3
	XORWF ESTADO, W
	BTFSC STATUS, Z
	GOTO ESTADO_3

SAI_INTERUP_3
	DECFSZ CONTIMER, F
	GOTO SAI_INTERUP_2

	; MAQUINA DE ESTADOS
	MOVLW .0
	XORWF ESTADO, W
	BTFSC STATUS, Z
	GOTO ESTADO_0
	
	MOVLW .1
	XORWF ESTADO, W
	BTFSC STATUS, Z
	GOTO ESTADO_1

	MOVLW .2
	XORWF ESTADO, W
	BTFSC STATUS, Z
	GOTO ESTADO_2

SAI_INTERUP
	; REGULA O CONTADOR DA INTERUP
	MOVLW .10
	MOVWF CONTIMER

SAI_INTERUP_2
	; RESTAURA CONTEXTO
	CALL RESET_TIMER
	SWAPF STATUS_TEMP, W
	MOVWF STATUS
	SWAPF W_TEMP, F
	SWAPF W_TEMP, W
	RETFIE

INICIO
	BANK_LOW
	BANK0
	; MODO DIGITAL
	;MOVLW .7
	;MOVWF ADCON0

	; CONFIGURA ENTRADAS/SAIDAS
	BANK1
	MOVLW .7
	MOVWF CMCON
	;MOVLW B'00001111' ; BOTOES COMO ENTRADA
	;MOVWF TRISB
	CALL AJUSTA_ENTRADA
	BANK1
	MOVLW B'00000000' ; DISPLAY SAIDA
	MOVWF TRISD
	MOVLW B'00000000' ; BUZZER SAIDA
	MOVWF TRISA
	BANK0

	CLRF PORTD
	CLRF PORTA
	; LEDS APAGADOS DE INICIO
	MOVLW B'10001111'
	MOVWF PORTB

	; CONFIGURA INTERRUPCAO
	BANK1
	MOVLW B'10000010' ; PRESCALE 
	MOVWF OPTION_REG
	BANK0
	MOVLW .10
	MOVWF CONTIMER

	; VALORES INICIAS
	MOVLW .0
	MOVWF ESTADO
	
	; GARANTE FSR TRABALHANDO NO BANK0-1
	BCF STATUS,IRP

	MOVLW .1
	MOVWF PROX_POS

	; LIGA INTERRUPCAO
	CALL RESET_TIMER
	BSF INTCON, TMR0IE
	BSF INTCON, GIE

	; CARREGA DELAY
	MOVLW .255	
	MOVWF DELAY
	
	GOTO MAIN

MAIN
	DECFSZ DELAY, F
	GOTO   MAIN
	
	MOVLW .255
	MOVWF DELAY
	GOTO TESTA_BT0

AJUSTA_SAIDA
	BANK1
	MOVLW B'00000000'
	MOVWF TRISB
	BANK0
	RETURN

AJUSTA_ENTRADA
	MOVLW B'10001111'
	MOVWF PORTB
	BANK1
	MOVLW B'00001111'
	MOVWF TRISB
	BANK0
 	MOVLW .255
	MOVWF FILTRO_BT0
	MOVWF FILTRO_BT1
 	MOVWF FILTRO_BT2 ; REINICIALIZA FILTRO
	MOVWF FILTRO_BT3
	MOVLW B'11111111'
	MOVWF STATUS_BTS
	RETURN

FACIL ; T-ACESO = 2s T-ENTRE = 1s
	; REGULA TEMPO ENTRE OS LEDS
	MOVLW .100
	MOVWF MULT1

	; REGULA TEMPO LED ACESSO
	MOVLW .50
	MOVWF MULT2

	CALL AJUSTA_SAIDA ; REGULA TRISB COMO SAIDA
	MOVLW B'10000001' ; ACENDE LED 0
	MOVWF PORTB

	GOTO  COMECA_JOGO

MEDIO ; T-ACESO= 1s T-ENTRE = 500ms
	; REGULA TEMPO ENTRE OS LEDS
	MOVLW .50
	MOVWF MULT1

	; REGULA TEMPO LED ACESSO
	MOVLW .25
	MOVWF MULT2

	CALL AJUSTA_SAIDA ; REGULA TRISB COMO SAIDA
	MOVLW B'10000010' ; ACENDE LED 1
	MOVWF PORTB
	GOTO  COMECA_JOGO

DIFICIL ; T-ACESO = 800ms T-ENTRE = 200ms
	; REGULA TEMPO ENTRE OS LEDS
	MOVLW .40
	MOVWF MULT1

	; REGULA TEMPO LED ACESSO
	MOVLW .10
	MOVWF MULT2

	CALL AJUSTA_SAIDA ; REGULA TRISB COMO SAIDA
	MOVLW B'10000100' ; ACENDE LED 2
	MOVWF PORTB
	GOTO  COMECA_JOGO

COMECA_JOGO
	; CARREGA VALORES DA DIFICULDADE
	MOVF  MULT1, W
	MOVWF CONT1
	MOVF  MULT2, W
	MOVWF CONT2
	
	; PEGA PRIMEIRA POSICAO
	MOVLW 0xA0
	MOVWF FSR
	MOVF  PROX_POS, W
	MOVWF INDF
	
	; VALOR PADRAO
	MOVLW .0
	MOVWF ACERTOS
	MOVWF ACERTOS2
	
	; RESETA O TEMPO PARA GARANTIR UNIFORME
	CALL RESET_TIMER
	MOVLW .10
	MOVWF CONTIMER

	; MODO EXIBICAO
	MOVLW .1
	MOVWF ESTADO

	GOTO MAIN

APERTA_0
	MOVLW .1
	CALL TABELA_DISPLAY_7_SEG
	MOVWF DISPLAY
	MOVLW .1
	GOTO FAZ_JOGADA

APERTA_1
	MOVLW .2
	CALL TABELA_DISPLAY_7_SEG
	MOVWF DISPLAY
	MOVLW .2
	GOTO FAZ_JOGADA

APERTA_2
	MOVLW .3
	CALL TABELA_DISPLAY_7_SEG
	MOVWF DISPLAY
	MOVLW .3
	GOTO FAZ_JOGADA

APERTA_3
	MOVLW .4
	CALL TABELA_DISPLAY_7_SEG
	MOVWF DISPLAY
	MOVLW .4
	GOTO FAZ_JOGADA

FAZ_JOGADA
	XORWF INDF, W
	BTFSC STATUS,Z 
	GOTO  ACERTOU

	; ERROU
	CALL AJUSTA_ENTRADA
	MOVLW .100
	MOVWF DELAY2
	MOVLW .50
	MOVWF DELAY3

	MOVLW .3
	MOVWF ESTADO
	GOTO MAIN

ACERTOU
	; VERIFICA SE ESTA NA ULTIMA POSICAO
	MOVLW 0xA0
	ADDWF ACERTOS, W
	XORWF FSR, W
	BTFSC STATUS, Z
	GOTO ULT_POS
	
	; SENAO ESTIVER VAMOS VER A PROXIMA POSICAO
	INCF FSR, F
	GOTO MAIN

ULT_POS
	CALL AJUSTA_SAIDA
	INCF ACERTOS, F

	INCF ACERTOS2, F
	; CORRIGE O VALOR
	MOVF ACERTOS2, W	
	MOVLW 0x0F
	ANDWF ACERTOS2, W
	XORLW 0x0A
	BTFSS STATUS,Z
	GOTO  SEM_COR
	
	MOVLW 0x06
	ADDWF ACERTOS2, F

SEM_COR
	INCF FSR,F
	MOVF  PROX_POS, W
	MOVWF INDF

	MOVLW 0xA0
	MOVWF FSR

	MOVLW .1
	MOVWF ESTADO
	MOVF MULT1, W
	MOVWF CONT1
	MOVF MULT2, W
	MOVWF CONT2

	GOTO MAIN
	
TESTA_BT0
	MOVLW .1
	XORWF ESTADO, W
	BTFSC STATUS, Z
	GOTO  MAIN

 	BTFSC BT0 		; BOTÃO 0 PRESSIONADO?
 	GOTO BT0_LIB 	; NÃO
 					; SIM
	BTFSC STATUS_BTS,0
	GOTO TESTA_BT1

 	DECFSZ FILTRO_BT0,F ; DECREMENTA FILTRO DO BOTÃO. ACABOU?
 	GOTO TESTA_BT1 		; NÃO - TESTA PRÓXIMO BOTÃO
 	BSF STATUS_BTS,0 	; SIM - MARCA BOTÃO COMO PRESSIONADO

	; SELECIONA DIFICULDADE FACIL
	MOVLW .0
	XORWF ESTADO, W
	BTFSC STATUS,Z
	GOTO  FACIL

	MOVLW .2
	XORWF ESTADO, W
	BTFSC STATUS, Z
	GOTO  APERTA_0

	MOVLW .3
	XORWF ESTADO, W
	BTFSC STATUS, Z
	GOTO  INICIO

 	GOTO TESTA_BT1 	; TESTA PRÓXIMO BOTÃO

BT0_LIB
 	MOVLW FILTRO_BTS
 	MOVWF FILTRO_BT0 ; REINICIALIZA FILTRO
 	BCF STATUS_BTS,0 ; MARCA BOTÃO COMO LIBERADO

TESTA_BT1
	MOVLW .1
	XORWF ESTADO, W
	BTFSC STATUS, Z
	GOTO  MAIN

 	BTFSC BT1 		; BOTÃO 0 PRESSIONADO?
 	GOTO BT1_LIB 	; NÃO
 					; SIM
	BTFSC STATUS_BTS,1
	GOTO TESTA_BT2

 	DECFSZ FILTRO_BT1,F ; DECREMENTA FILTRO DO BOTÃO. ACABOU?
 	GOTO TESTA_BT2 		; NÃO - TESTA PRÓXIMO BOTÃO
 	BSF STATUS_BTS,1 	; SIM - MARCA BOTÃO COMO PRESSIONADO

	MOVLW .0
	XORWF ESTADO, W
	BTFSC STATUS,Z
	GOTO  MEDIO

	MOVLW .2
	XORWF ESTADO, W
	BTFSC STATUS, Z
	GOTO  APERTA_1

	MOVLW .3
	XORWF ESTADO, W
	BTFSC STATUS, Z
	GOTO  INICIO

 	GOTO TESTA_BT2 	; TESTA PRÓXIMO BOTÃO

BT1_LIB
 	MOVLW FILTRO_BTS
 	MOVWF FILTRO_BT1 ; REINICIALIZA FILTRO
 	BCF STATUS_BTS,1 ; MARCA BOTÃO COMO LIBERADO

TESTA_BT2
	MOVLW .1
	XORWF ESTADO, W
	BTFSC STATUS, Z
	GOTO  MAIN

 	BTFSC BT2 		; BOTÃO 0 PRESSIONADO?
 	GOTO BT2_LIB 	; NÃO
 					; SIM
	BTFSC STATUS_BTS,2
	GOTO TESTA_BT3

 	DECFSZ FILTRO_BT2,F ; DECREMENTA FILTRO DO BOTÃO. ACABOU?
 	GOTO TESTA_BT3 		; NÃO - TESTA PRÓXIMO BOTÃO
 	BSF STATUS_BTS,2 	; SIM - MARCA BOTÃO COMO PRESSIONADO
	
	MOVLW .0
	XORWF ESTADO, W
	BTFSC STATUS,Z
	GOTO  DIFICIL

	MOVLW .2
	XORWF ESTADO, W
	BTFSC STATUS, Z
	GOTO  APERTA_2

	MOVLW .3
	XORWF ESTADO, W
	BTFSC STATUS, Z
	GOTO  INICIO

 	GOTO TESTA_BT3 	; TESTA PRÓXIMO BOTÃO

BT2_LIB
 	MOVLW FILTRO_BTS
 	MOVWF FILTRO_BT2 ; REINICIALIZA FILTRO
 	BCF STATUS_BTS,2 ; MARCA BOTÃO COMO LIBERADO

TESTA_BT3
	MOVLW .1
	XORWF ESTADO, W
	BTFSC STATUS, Z
	GOTO  MAIN

 	BTFSC BT3 		; BOTÃO 1 PRESSIONADO?
 	GOTO BT3_LIB 	; NÃO - TRATA BOTÃO COMO LIBERADO
 					; SIM

	BTFSC STATUS_BTS,3
	GOTO MAIN

 	DECFSZ FILTRO_BT3,F ; DECREMENTA FILTRO DO BOTÃO. ACABOU?
 	GOTO MAIN 		; NÃO - TESTA PRÓXIMO BOTÃO
 	BSF STATUS_BTS,3 	; SIM - MARCA BOTÃO COMO PRESSIONADO

	MOVLW .2
	XORWF ESTADO, W
	BTFSC STATUS, Z
	GOTO  APERTA_3

	MOVLW .3
	XORWF ESTADO, W
	BTFSC STATUS, Z
	GOTO  INICIO

 	GOTO MAIN ; TESTA PRÓXIMO BOTÃO

BT3_LIB
 	MOVLW FILTRO_BTS4
 	MOVWF FILTRO_BT3 ; REINICIALIZA FILTRO
 	BCF STATUS_BTS,3 ; MARCA BOTÃO COMO LIBERADO
	GOTO MAIN
END