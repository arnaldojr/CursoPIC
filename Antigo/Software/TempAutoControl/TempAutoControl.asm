;CONTROLE AUTOMATICO DE TEMPERATURA. PROGRAMA COMPLETO
 #INCLUDE<P16F877A.INC>
 REG1    		EQU 20H
 REG2    		EQU 21H
 CONT    		EQU 22H
 CH0L    		EQU 23H
 CH0H    		EQU 24H
 VAR1    		EQU 25H
 VAR2    		EQU 26H
 UNI    		EQU 27H
 DEC     		EQU 28H
 CEN     		EQU 29H
 X             	EQU 30H
 CH             EQU 31H
 TEMPERATURA    EQU 32H
 POTENCIOMETRO  EQU 33H
 LOOP3          EQU 34H

 org 0x00
 GOTO INICIO
;------------------------SUB ROTINA DE CONFIGURAÇÃO--------------
 CONFIGURA
 BSF STATUS,RP0
 BCF STATUS,RP1
 MOVLW B'11111111'
 MOVWF TRISA
 MOVLW B'00001111'
 MOVWF TRISB
 MOVLW B'11111001'
 MOVWF TRISC
 MOVLW 0X00
 MOVWF TRISD
 MOVWF TRISE
 MOVLW B'10000010'
 MOVWF ADCON1 ;HABILITA ENTRADAS ANALOGICAS!
 MOVLW B'10000000'
 MOVWF OPTION_REG
 BCF STATUS,RP0
 MOVLW B'01000001'
 MOVWF ADCON0
 MOVLW .0
 MOVWF CH
 CALL ATRASO_1S
 CALL INICIA_LCD
 MOVLW 0X00
 MOVWF CH0L
 MOVWF CH0H
 RETURN
;--------------------FIM DA CONFIGURAÇÃO -----------------------
;-------------------SUB ROTINAS DE ATRASOS ---------------------
 ATRASO_1MS
 ATRASO_1S
;------------------------------FIM DOS ATRASOS--------------------------------
;----------------SUB ROTINAS AD---------------------------------
 LER_ADC
	BSF 	ADCON0,GO
	BTFSC 	ADCON0,GO
	GOTO 	$-1
	BSF 	STATUS,RP0
	MOVF 	ADRESL,W
	BCF 	STATUS,RP0
	MOVWF 	CH0L
	MOVF 	ADRESH,W
	MOVWF	 CH0H
 RETURN

 CONVERSAO_BIT_DEC; CONVERTENDO PARA 8 BITS
	CLRF	UNI
	CLRF	DEC
	CLRF 	CEN
	 BTFSC CH0H,1
	 BSF X,7
	 BTFSS CH0H,1
	 BCF X,7

	 BTFSC CH0H,0
	 BSF X,6
	 BTFSS CH0H,0
	 BCF X,6

	 BTFSC CH0L,7
	 BSF X,5
	 BTFSS CH0L,7
	 BCF X,5

	 BTFSC CH0L,6
	 BSF X,4
	 BTFSS CH0L,6
	 BCF X,4

	 BTFSC CH0L,5
	 BSF X,3
	 BTFSS CH0L,5
	 BCF X,3

	 BTFSC CH0L,4
	 BSF X,2
	 BTFSS CH0L,4
	 BSF X,2

	 BTFSC CH0L,3
	 BSF X,1
	 BTFSS CH0L,3
	 BCF X,1

	 BTFSC CH0L,2
	 BSF X,0
	 BTFSS CH0L,2
	 BCF X,0
	 BTFSC CH,0  	 ;ch=0-->temperatura
	 GOTO TESTA_POT
	TESTA 
	 MOVF  X,W
	 MOVWF TEMPERATURA
	 TESTA1
	 MOVLW .0
	 SUBWF X,W
	 BTFSC STATUS,Z
	 GOTO EXIBE_TEMP
	 DECF X,F
	 INCF CEN,F
	 INCF CEN,F
	 MOVLW .10
	 SUBWF CEN,W
	 BTFSS STATUS,Z
	 GOTO TESTA1
	 CLRF CEN
	 INCF DEC,F
	 MOVLW .10
	 SUBWF DEC,W
	 BTFSS STATUS,Z
	 GOTO TESTA1
	 CLRF DEC
	 INCF UNI,F
	 GOTO TESTA1

 TESTA_POT
	 MOVF  X,W
	 MOVWF POTENCIOMETRO
	TESTA_POT1
	 MOVLW .0
	 SUBWF X,F
	 BTFSC STATUS,Z
	 GOTO EXIBE_POT
	 DECF X,F      ;;;
	 INCF CEN,F
	 INCF CEN,F
	 MOVLW .10
	 SUBWF CEN,W
	 BTFSS STATUS,Z
	 GOTO TESTA_POT1
	 CLRF CEN      ;;;
	 INCF DEC,F
	 MOVLW .10
	 SUBWF DEC,W
	 BTFSS STATUS,Z
	 GOTO TESTA_POT1
	 CLRF DEC     ;;;
	 INCF UNI,F
	 GOTO TESTA_POT1

 CHANGE_CHANNEL
	 BTFSC CH,0
	 GOTO CHANNEL_0
	 BTFSS CH,0
	 GOTO CHANNEL_1
	 RETORNAR
 RETURN
 CHANNEL_0
	 BCF CH,0
	 ;CANAL 0:
	 MOVLW B'01000001'
	 MOVWF ADCON0
GOTO RETORNAR
 CHANNEL_1
	 BSF CH,0
	 ;CANAL 1:
	 MOVLW B'01001001'
	 MOVWF ADCON0
 GOTO RETORNAR
;---------------------------FIM DO AD----------------------------------
;-----------------------SUB ROTINA DO DISPLAY--------------------
 INICIA_LCD
 MOVLW 0X38
 CALL ESCREVE_COMANDO
 CALL ATRASO_1MS
 CALL ATRASO_1MS
 CALL ATRASO_1MS
 MOVLW 0X38
 CALL ESCREVE_COMANDO
 MOVLW 0X0C
 CALL ESCREVE_COMANDO
 MOVLW 0X06
 CALL ESCREVE_COMANDO
 MOVLW 0X01
 CALL ESCREVE_COMANDO
 CALL ATRASO_1MS
 RETURN

 ESCREVE_DADO ;ESCREVE CARACTERES NO LCD 
 BSF PORTE,0 ;SINAL DE DADO
 NOP
 MOVWF PORTD ;INFORMAÇÃO NA PORTA D DE DAOD
 NOP
 NOP
 BSF PORTE,1 ;PULSO DE ENABLE
 NOP
 NOP
 BCF PORTE,1 
 CALL ATRASO_1MS ;ATRSO DE 1ms
 RETURN

 DECODER
 ADDWF PCL,F
 RETLW '0'
 RETLW '1'
 RETLW '2'
 RETLW '3'
 RETLW '4'
 RETLW '5'
 RETLW '6'
 RETLW '7'
 RETLW '8'
 RETLW '9'

 ESCREVE_COMANDO ;ENVIA COMANDO AO LCD
 BCF PORTE,0 ;SINAL DE COMANDO
 NOP
 MOVWF PORTD ;INFORMAÇÃO NA PORTA D DE DAOD
 NOP
 NOP
 BSF PORTE,1 ;PULSO DE ENABLE
 NOP
 NOP
 BCF PORTE,1 
 CALL ATRASO_1MS ;ATRSO DE 1ms
 RETURN

 EXIBE_TEMP
 MOVLW 0X80
 CALL ESCREVE_COMANDO
 MOVLW 'T'
 CALL ESCREVE_DADO
 MOVLW 'E'
 CALL ESCREVE_DADO
 MOVLW 'M'
 CALL ESCREVE_DADO
 MOVLW 'P'
 CALL ESCREVE_DADO
 MOVLW ':'
 CALL ESCREVE_DADO
 MOVF UNI,W
 CALL DECODER
 CALL ESCREVE_DADO
 MOVLW ','
 CALL ESCREVE_DADO
 MOVF DEC,W
 CALL DECODER
 CALL ESCREVE_DADO
 MOVF CEN,W
 CALL DECODER
 CALL ESCREVE_DADO
 RETURN

 EXIBE_POT
 MOVLW 0X80
 CALL ESCREVE_COMANDO
 MOVLW 0xC0
 CALL ESCREVE_COMANDO
 MOVLW 'P'
 CALL ESCREVE_DADO
 MOVLW 'O'
 CALL ESCREVE_DADO
 MOVLW 'T'
 CALL ESCREVE_DADO
 MOVLW ':'
 CALL ESCREVE_DADO
 MOVF UNI,W
 CALL DECODER
 CALL ESCREVE_DADO
 MOVLW ','
 CALL ESCREVE_DADO
 MOVF DEC,W
 CALL DECODER
 CALL ESCREVE_DADO
 MOVF CEN,W
 CALL DECODER
 CALL ESCREVE_DADO
 RETURN
;-------------------FIM DO DISPLAY------------------------------
;----------------SUB ROTINA DOS BOTÕES -------------------------
BOTAO1
	 MOVLW 	.100
	 ADDWF 	VAR1,F
	 BTFSC 	STATUS,C
	 INCF 	VAR2,F
	 CALL 	ATUALIZA_PWM1
	 CALL 	ATRASO_1S
	 BTFSS 	PORTB,3
	 GOTO 	$-1
 RETURN
INCREMENTA
	MOVLW 	.5
	ADDWF 	VAR1,F
	BTFSC 	STATUS,C
	INCF  	VAR2,F
	BTFSC 	VAR2,2
	GOTO 	MAX
	CALL 	ATUALIZA_PWM1
RETURN
MAX
	MOVLW 	0XFF
	MOVWF 	VAR1
	MOVLW 	B'00000011'
	MOVWF 	VAR2
	CALL  	ATUALIZA_PWM1
RETURN
DECREMENTA
	 MOVF  	VAR1,W
	 BTFSS 	STATUS,Z
	 GOTO   OUTROTESTE
	 MOVF 	VAR2,W
	 BTFSC  STATUS,Z
RETURN
OUTROTESTE
	 MOVLW 	.15
	 SUBWF 	VAR1,F
	 BTFSS 	STATUS,C
	 GOTO 	TESTE_VAR2		;DEU NEGATIVO VAR1
	 CALL 	ATUALIZA_PWM1 	;BLZ VAR1 É ZERO VAR2 NAO MUDA
 RETURN
TESTE_VAR2
	 MOVF 	VAR2,W
	 BTFSS  STATUS,Z
	 GOTO 	DEC_VAR2
	 CLRF 	VAR1
	 CLRF 	VAR2
	 CALL 	ATUALIZA_PWM1
RETURN
	DEC_	VAR2
	ECF 	VAR2
	CALL 	ATUALIZA_PWM1
RETURN
;------------------------FIM DOS BOTÕES----------------------------------------
;----------------SUB ROTINAS DO PWM --------------------------------
 ATUALIZA_PWM1 ;ATUALIZA O VALOR DA LARGURA DE PULSO DO PWM.
 BTFSC VAR1,0
 BSF CCP1CON,4
 BTFSS VAR1,0
 BCF CCP1CON,4

 BTFSC VAR1,1
 BSF CCP1CON,5
 BTFSS VAR1,1
 BCF CCP1CON,5

 BTFSC VAR1,2
 BSF CCPR1L,0
 BTFSS VAR1,2
 BCF CCPR1L,0

 BTFSC VAR1,3
 BSF CCPR1L,1
 BTFSS VAR1,3
 BCF CCPR1L,1

 BTFSC VAR1,4
 BSF CCPR1L,2
 BTFSS VAR1,4
 BCF CCPR1L,2

 BTFSC VAR1,5
 BSF CCPR1L,3
 BTFSS VAR1,5
 BCF CCPR1L,3

 BTFSC VAR1,6
 BSF CCPR1L,4
 BTFSS VAR1,6
 BCF CCPR1L,4

 BTFSC VAR1,7
 BSF CCPR1L,5
 BTFSS VAR1,7
 BCF CCPR1L,5

 BTFSC VAR2,0
 BSF CCPR1L,6
 BTFSS VAR2,0
 BCF CCPR1L,6

 BTFSC VAR2,1
 BSF CCPR1L,7
 BTFSS VAR2,1
 BCF CCPR1L,7
 RETURN

 HABILITA_PWM
	 MOVLW 	B'00001111' 
	 MOVWF 	CCP1CON ;HABILITA PWM1
	 MOVWF 	CCP2CON ;HABILITA PWM2
	 MOVLW 	B'00001111'
	 MOVWF 	CCPR1L ;0%
	 CLRF 	CCPR2L ;0%
	 BSF 	STATUS,RP0
	 MOVLW 	0xFF
	 MOVWF 	PR2 ;RESOLUÇÃO DE 10 BITS
	 BCF 	STATUS,RP0
	 BSF 	T2CON,TMR2ON ;TIMER LIGADO
	 MOVLW 	.0
	 MOVWF 	VAR1
	 MOVLW 	.0
	 MOVWF 	VAR2
 RETURN
;------------------FIM PWM ---------------------------------------
;-------------------PROGRAMA PRINCIPAL ---------------------------
 INICIO
	 CALL CONFIGURA
	 CALL HABILITA_PWM
	 CLRF CH
 LOOP
	 CALL ATRASO_1MS
	 CALL LER_ADC
	 CALL CONVERSAO_BIT_DEC
	 CALL CHANGE_CHANNEL
	 CALL LER_ADC
	 CALL CONVERSAO_BIT_DEC
	 CALL CHANGE_CHANNEL
	 MOVF POTENCIOMETRO,W
	 SUBWF TEMPERATURA,W
	 BTFSC STATUS,Z
  GOTO LOOP
	 BTFSS STATUS,C
  GOTO AUMENTA
  GOTO DIMINUI

AUMENTA
	CALL INCREMENTA
	CALL ATRASO_1S
GOTO LOOP

DIMINUI
CALL DECREMENTA
CALL ATRASO_1S
GOTO LOOP

END