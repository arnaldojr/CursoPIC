		;ENDEREÇAMENTO INDIRETO
 #INCLUDE<P16F877A.INC>
 REG1		EQU 20H
 REG2		EQU 21H
 CONT		EQU 22H
 NAPERTO	EQU 23H
 TEMPO1		EQU 24H
 TEMPO2		EQU 25H

 org 0x00
 GOTO INICIO
 
;------------------------SUB ROTINA DE CONFIGURAÇÃO--------------
 CONFIGURA
 BSF	 STATUS,RP0
 BCF	 STATUS,RP1
 MOVLW	 B'11111111'
 MOVWF	 TRISA
 MOVLW	 B'00001111'
 MOVWF	 TRISB
 MOVLW	 B'11111001'
 MOVWF	 TRISC
 MOVLW	 0X00
 MOVWF	 TRISD
 MOVWF	 TRISE
 BCF	 STATUS,RP0
 RETURN
;--------------------FIM DA CONFIGURAÇÃO -----------------------
;-------------------SUB ROTINAS DE ATRASOS ---------------------

 ATRASO_1MS
 	MOVLW	.255
 	MOVWF 	REG1
       VOLTA
 	DECF	REG1,F
	BTFSS 	STATUS,Z
	GOTO 	VOLTA
 RETURN

 ATRASO_1S
 	MOVLW 	.10
 	MOVWF 	CONT
       VOLT
 	CALL 	ATRASO_100MS 
 	DECF	CONT,F
	BTFSS 	STATUS,Z
 	GOTO 	VOLT
 RETURN

 ATRASO_100MS
	MOVLW 	.100
	MOVWF 	TEMPO1
	TEMPO_1
	MOVLW 	.255
	MOVWF 	TEMPO2
	TEMPO_2
	DECF 	TEMPO2,F
	BTFSS 	STATUS,Z
	GOTO 	TEMPO_2
	DECF 	TEMPO1,F
	BTFSS 	STATUS,Z
	GOTO 	TEMPO_1
 RETURN
;------------FIM DOS ATRASOS-------------------------------
;------------TRATAMENTO BOTÃO------------------------------

SALVA0
CALL 	ATRASO_100MS
BTFSC 	PORTB,0 	 ; BOT0 ESTA APERTADO?
RETURN  		 ; NÃO ESTA APERTADO
MOVLW 	B'00111111' 
MOVWF	INDF
INCF 	FSR,F
INCF 	NAPERTO,F
MOVLW 	B'00111111'
MOVWF 	PORTD
BSF  	PORTB,6
CALL  	ATRASO_1S
BCF  	PORTB,6
RETURN

SALVA1
CALL 	ATRASO_100MS
BTFSC 	PORTB,1  	; BOT0 ESTA APERTADO?
RETURN    		; NÃO ESTA APERTADO
MOVLW 	B'00000110' 
MOVWF 	INDF
INCF 	FSR,F
INCF 	NAPERTO,F
MOVLW 	B'00000110'
MOVWF 	PORTD
BSF  	PORTB,5
CALL 	ATRASO_1S
BCF  	PORTB,5
RETURN

SALVA2
CALL 	ATRASO_100MS
BTFSC 	PORTB,2 	; BOT0 ESTA APERTADO?
RETURN  	  	; NÃO ESTA APERTADO
MOVLW 	B'01011011' 
MOVWF	INDF
INCF 	FSR,F
INCF 	NAPERTO,F
MOVLW 	B'01011011'
MOVWF 	PORTD
BSF  	PORTB,4
CALL  	ATRASO_1S
BCF  	PORTB,4
RETURN

EXIBETUDO
CALL 	ATRASO_100MS
BTFSC	PORTB,3  	; BOT0 ESTA APERTADO?
RETURN    		; NÃO ESTA APERTADO
MOVLW 	0X00
SUBWF 	NAPERTO,W
BTFSS 	STATUS,Z 	;DEU ZERO?
GOTO 	SEGUE 	 	;NÃO, ENTÃO VOLTA
MOVLW 	B'11111001'  	;SIM, DEU ZERO
MOVWF 	PORTD
MOVLW 	B'11110000'
MOVWF 	PORTB
CALL  	ATRASO_1S
CLRF 	PORTB
RETURN

SEGUE
MOVLW 	0X40
MOVWF 	FSR
LOOP
MOVF 	INDF,W
MOVWF 	PORTD
BSF  	PORTB,7
CALL  	ATRASO_1S
BCF  	PORTB,7
INCF 	FSR,F
DECF 	NAPERTO,F
MOVLW 	0X00
SUBWF 	NAPERTO,W
BTFSS 	STATUS,Z 	;DEU ZERO?
GOTO 	LOOP  		;NÃO, ENTÃO VOLTA
MOVLW 	0X40  		;SIM, DEU ZERO
MOVWF 	FSR
CLRF 	NAPERTO 
RETURN   
;------------***********************------------------------------

;-------------------PROGRAMA PRINCIPAL ---------------------------
INICIO
CALL 	CONFIGURA
MOVLW 	0X40
MOVWF 	FSR
CLRF 	PORTB
CLRF 	INDF
CLRF 	NAPERTO

BOT0
 BTFSC	PORTB,0  	; BOT0 ESTA APERTADO?
 GOTO 	BOT1  		; NÃO ESTA APERTADO
 CALL 	SALVA0  	; ESTA APERTADO
BOT1 
 BTFSC 	PORTB,1  	; BOT0 ESTA APERTADO?
 GOTO 	BOT2  		; NÃO ESTA APERTADO
 CALL 	SALVA1  	; ESTA APERTADO
BOT2 
 BTFSC 	PORTB,2  	; BOT0 ESTA APERTADO?
 GOTO 	BOT3  		; NÃO ESTA APERTADO
 CALL 	SALVA2  	; ESTA APERTADO
BOT3 
 BTFSC 	PORTB,3  	; BOT0 ESTA APERTADO?
 GOTO 	BOT0  		; NÃO ESTA APERTADO
 CALL 	EXIBETUDO 	; ESTA APERTADO
 GOTO 	BOT0

END