;RELOGIO COM BOTÃO
#INCLUDE <P16F877A.INC>
__CONFIG  _BODEN_ON & _CP_OFF & _PWRTE_ON & _WDT_OFF & _LVP_OFF & _XT_OSC

#DEFINE BANK0 BCF STATUS,RP0 ; SETA BANK 0 DE MEMORIA
#DEFINE BANK1 BSF STATUS,RP0 ; SETA BANK 1 DE MEMORIA

CBLOCK 0X20
W_TEMP
STATUS_TEMP
UMSEG
REG1
CONT
SEG
DSEG
MIN
DMIN
HR
DHR
TEMPO1
TEMPO2
ENDC

ORG     0X00
GOTO INICIO 
;----------------------------INICIO DA INTERRUPÇÃO-----------
ORG     0X04  ;VETOR DE INTERRUPÇÃO
MOVWF W_TEMP
SWAPF STATUS,W
MOVWF STATUS_TEMP
MOVLW .217
MOVWF TMR0

INCF UMSEG,F
MOVLW .100
SUBWF UMSEG,W
BTFSS STATUS,Z ;DEU 1SEG?
GOTO VOLTA  ;NÃO DEU 1SEG
CLRF UMSEG  ;SIM DEU 1SEG
    
INCF SEG,F   ;TESTA SEG 
MOVLW .10
SUBWF SEG,W
BTFSS STATUS,Z   
GOTO VOLTA
CLRF SEG
CALL EXIBESEG

INCF DSEG,F  ;TESTA DSEG
MOVLW .6
SUBWF DSEG,W
BTFSS STATUS,Z   
GOTO VOLTA
CLRF DSEG
CALL EXIBEDSEG

INCF MIN,F   ;TESTA MIN 
MOVLW .10
SUBWF MIN,W
BTFSS STATUS,Z   
GOTO VOLTA
CLRF MIN
CALL EXIBEMIN

INCF DMIN,F   ;TESTA DMIN 
MOVLW .6
SUBWF DMIN,W
BTFSS STATUS,Z   
GOTO VOLTA
CLRF DMIN
CALL EXIBEDMIN


MOVLW .2    ;TESTA HR
SUBWF DHR,W
BTFSC STATUS,Z   
GOTO ALTERAHR4
INCF HR,F    
MOVLW .10
SUBWF HR,W
BTFSS STATUS,Z   
GOTO VOLTA
CLRF HR
CALL EXIBEHR

INCF DHR,F   ;TESTA DHR 
CALL EXIBEDHR
GOTO VOLTA
;MOVLW .2
;SUBWF DHR,W
;BTFSS STATUS,Z   
;GOTO ALTERADHR
;CLRF DHR
;CALL EXIBEDHR


ALTERAHR
 INCF HR,F
 GOTO VOLTA

ALTERAHR4
 MOVLW .3
 SUBWF HR,W
 BTFSS STATUS,Z
   
 GOTO ALTERAHR
 CLRF DHR
 CLRF HR
 CALL EXIBEHR
 CALL EXIBEDHR 
 GOTO VOLTA

ALTERADHR
 GOTO VOLTA

VOLTA

SWAPF STATUS_TEMP,W
MOVWF STATUS
SWAPF W_TEMP,F
SWAPF W_TEMP,W


BCF  INTCON,2
RETFIE
 
;----------------FIM DA INTERRUPÇÃO-----------------------

;--------------------INICIO SUB ROTINAS------------------------

;-----------CONFIGURAÇÃO-----------------
CONFIGURA
BANK1      ;ALTERA PARA BANCO 1
BCF STATUS,RP1;
MOVLW 0XFF       ; CONFIGURA I/O DO PORTA
MOVWF TRISA 
MOVLW 0X0F       ; CONFIGURA I/O DO PORTB
MOVWF TRISB 
MOVLW B'11111001'    ; CONFIGURA I/O DO PORTC
MOVWF TRISC 
MOVLW B'00000000'    ; CONFIGURA I/O DO PORTD
MOVWF TRISD 
MOVWF TRISE 
MOVLW B'10000111'    ; CONFIGURA OPTION REG
MOVWF OPTION_REG
MOVLW .7
MOVWF ADCON1
MOVWF CMCON
MOVLW B'10100000'    
MOVWF INTCON   ; HABILITA A INTERRUPÇÃO DO TIMER0
BANK0  
MOVLW .217
MOVWF TMR0
RETURN
;-----------FIM DA CONFIGURAÇÃO-----------------
;-------------------ATRASOS ---------------------

 ATRASO_1MS
 MOVLW .255
 MOVWF REG1
 VOLTA1
 DECF REG1,F
 BTFSS STATUS,Z
 GOTO VOLTA1
 RETURN

 ATRASO_1S
 MOVLW .255
 MOVWF CONT
 VOLT
 CALL ATRASO_1MS 
 DECF CONT,F
 BTFSS STATUS,Z
 GOTO VOLT
 RETURN

ATRASO_100MS
MOVLW .100
MOVWF TEMPO1
TEMPO_1
MOVLW .255
MOVWF TEMPO2
TEMPO_2
DECF TEMPO2,F
BTFSS STATUS,Z
GOTO TEMPO_2
DECF TEMPO1,F
BTFSS STATUS,Z
GOTO TEMPO_1
RETURN

;------------------------------FIM DOS ATRASOS--------------------------------
;-----------------------SUB ROTINA DO DISPLAY--------------------

 INICIA_LCD
 MOVLW 0X38
 CALL ESCREVE_COMANDO
 CALL ATRASO_1MS
 CALL ATRASO_1MS
 CALL ATRASO_1MS
 MOVLW 0X38
 CALL ESCREVE_COMANDO
 MOVLW 0X0C
 CALL ESCREVE_COMANDO
 MOVLW 0X06
 CALL ESCREVE_COMANDO
 MOVLW 0X01
 CALL ESCREVE_COMANDO
 CALL ATRASO_1MS
 RETURN

 ESCREVE_DADO ;ESCREVE CARACTERES NO LCD 
 BSF PORTE,0 ;SINAL DE DADO
 NOP
 MOVWF PORTD ;INFORMAÇÃO NA PORTA D DE DAOD
 NOP
 NOP
 BSF PORTE,1 ;PULSO DE ENABLE
 NOP
 NOP
 BCF PORTE,1 
 CALL ATRASO_1MS ;ATRSO DE 1ms
 RETURN

 DECODER
 ADDWF PCL,F
 RETLW '0'
 RETLW '1'
 RETLW '2'
 RETLW '3'
 RETLW '4'
 RETLW '5'
 RETLW '6'
 RETLW '7'
 RETLW '8'
 RETLW '9'

 ESCREVE_COMANDO ;ENVIA COMANDO AO LCD
 BCF PORTE,0 ;SINAL DE COMANDO
 NOP
 MOVWF PORTD ;INFORMAÇÃO NA PORTA D DE DAOD
 NOP
 NOP
 BSF PORTE,1 ;PULSO DE ENABLE
 NOP
 NOP
 BCF PORTE,1 
 CALL ATRASO_1MS ;ATRSO DE 1ms
 RETURN
;--------------------------FIM DO DISPLAY------------------------------------
;------------EXIBE LCD---------------
EXIBESEG

MOVLW  0X8C    ;CURSOR DO LCD NAPRIMEIRA LINHA PRIMEIRA COLUNA
CALL  ESCREVE_COMANDO
MOVF SEG,W
CALL DECODER
CALL  ESCREVE_DADO
RETURN

EXIBEDSEG

MOVLW  0X8B    ;CURSOR DO LCD NAPRIMEIRA LINHA PRIMEIRA COLUNA
CALL  ESCREVE_COMANDO
MOVF DSEG,W
CALL DECODER
CALL  ESCREVE_DADO
RETURN

EXIBEMIN

MOVLW  0X89    ;CURSOR DO LCD NAPRIMEIRA LINHA PRIMEIRA COLUNA
CALL  ESCREVE_COMANDO
MOVF MIN,W
CALL DECODER
CALL  ESCREVE_DADO
RETURN

EXIBEDMIN

MOVLW  0X88    ;CURSOR DO LCD NAPRIMEIRA LINHA PRIMEIRA COLUNA
CALL  ESCREVE_COMANDO
MOVF DMIN,W
CALL DECODER
CALL  ESCREVE_DADO
RETURN

EXIBEHR

MOVLW  0X86    ;CURSOR DO LCD NAPRIMEIRA LINHA PRIMEIRA COLUNA
CALL  ESCREVE_COMANDO
MOVF HR,W
CALL DECODER
CALL  ESCREVE_DADO
RETURN

EXIBEDHR

MOVLW  0X85    ;CURSOR DO LCD NAPRIMEIRA LINHA PRIMEIRA COLUNA
CALL  ESCREVE_COMANDO
MOVF DHR,W
CALL DECODER
CALL  ESCREVE_DADO
RETURN


;----------------TRATAMENTO BOTOES
INCDHR
CALL ATRASO_100MS
BTFSC PORTB,0  ; BOT0 ESTA APERTADO?
RETURN
MOVLW .3
SUBWF HR,W   ; NÃO ESTA APERTADO
BTFSS STATUS,C
GOTO INCDHR1
INCF DHR,F
RETURN

INCDHR1
INCF DHR,F
MOVLW .3
SUBWF DHR,W
BTFSS STATUS,Z
RETURN
CLRF DHR
RETURN
 
INCHR
CALL ATRASO_100MS
BTFSC PORTB,1  ; BOT0 ESTA APERTADO?
RETURN    ; NÃO ESTA APERTADO

MOVLW .2    ;TESTA HR
SUBWF DHR,W
BTFSS STATUS,Z
GOTO NDEU2
MOVLW .3
SUBWF  HR,W
BTFSS STATUS,Z
GOTO NDEU2
CLRF HR
RETURN

NDEU2
INCF HR,F
MOVLW .10
SUBWF HR,W
BTFSS STATUS,Z
RETURN
CLRF HR
RETURN
 
INCDMIN
CALL ATRASO_100MS
BTFSC PORTB,2  ; BOT0 ESTA APERTADO?
RETURN    ; NÃO ESTA APERTADO
INCF DMIN,F
MOVLW .6
SUBWF DMIN,W
BTFSS STATUS,Z
RETURN
CLRF DMIN
RETURN
 
INCMIN
CALL ATRASO_100MS
BTFSC PORTB,3  ; BOT0 ESTA APERTADO?
RETURN    ; NÃO ESTA APERTADO
INCF MIN,F
MOVLW .10
SUBWF MIN,W
BTFSS STATUS,Z
RETURN
CLRF MIN
RETURN
 

 

;-----------------------PROGRAMA PRINCIPAL------------------------------------
INICIO

 CALL CONFIGURA
 CLRF UMSEG
 CLRF SEG
 CLRF DSEG
 CLRF MIN
 CLRF DMIN
 CLRF HR
 CLRF DHR

 CALL INICIA_LCD
 MOVLW 0X80    ;CURSOR DO LCD NAPRIMEIRA LINHA PRIMEIRA COLUNA
 CALL ESCREVE_COMANDO
 MOVLW 'H'
 CALL ESCREVE_DADO
 MOVLW 'O'
 CALL ESCREVE_DADO
 MOVLW 'R'
 CALL ESCREVE_DADO
 MOVLW 'A'
 CALL ESCREVE_DADO
 MOVLW ':'
 CALL ESCREVE_DADO
 MOVLW 0X87    
 CALL ESCREVE_COMANDO
 MOVLW ':'
 CALL ESCREVE_DADO
 MOVLW 0X8A    
 CALL ESCREVE_COMANDO
 MOVLW ':'
 CALL ESCREVE_DADO
 MOVLW .9 
 MOVWF MIN
 MOVLW .5
 MOVWF DMIN
 MOVLW .5 
 MOVWF SEG
 MOVLW .5
 MOVWF DSEG
 MOVLW .3 
 MOVWF HR
 MOVLW .0
 MOVWF DHR

LOOP
CALL EXIBEDHR
CALL EXIBEHR
CALL EXIBEDMIN
CALL EXIBEMIN
CALL EXIBEDSEG
CALL EXIBESEG
MOVLW 0X8D    
CALL ESCREVE_COMANDO
MOVLW ' '
CALL ESCREVE_DADO
MOVLW 0X87    
CALL ESCREVE_COMANDO
MOVLW ':'
CALL ESCREVE_DADO


 BTFSC PORTB,0  ; BOT0 ESTA APERTADO?
 GOTO BOT1  ; NÃO ESTA APERTADO
 CALL INCDHR   ; ESTA APERTADO
BOT1 
 BTFSC PORTB,1  ; BOT0 ESTA APERTADO?
 GOTO BOT2  ; NÃO ESTA APERTADO
 CALL INCHR  ; ESTA APERTADO
BOT2 
 BTFSC PORTB,2  ; BOT0 ESTA APERTADO?
 GOTO BOT3  ; NÃO ESTA APERTADO
 CALL INCDMIN  ; ESTA APERTADO
BOT3 
 BTFSC PORTB,3  ; BOT0 ESTA APERTADO?
 GOTO LOOP  ; NÃO ESTA APERTADO
 CALL INCMIN   ; ESTA APERTADO
 GOTO LOOP

 


GOTO LOOP
END