#INCLUDE <P16F877A.INC>
__CONFIG  _BODEN_ON & _CP_OFF & _PWRTE_ON & _WDT_OFF & _LVP_OFF & _XT_OSC
#DEFINE BANK0 BCF STATUS,RP0 ; SETA BANK 0 DE MEMORIA
#DEFINE BANK1 BSF STATUS,RP0 ; SETA BANK 1 DE MEMORIA
CBLOCK 0X20
W_TEMP
STATUS_TEMP
UMSEG
ENDC

ORG     0X00
GOTO INICIO

ORG     0X04  ;VETOR DE INTERRUPÇÃO
MOVWF W_TEMP
SWAPF STATUS,W
MOVWF STATUS_TEMP
MOVLW .217
MOVWF TMR0

INCF UMSEG
MOVLW .100
SUBWF UMSEG,W
BTFSS STATUS,Z
GOTO VOLTA
CLRF UMSEG
BTFSS PORTB,4
GOTO ACENDE
BCF  PORTB,4
GOTO VOLTA
ACENDE
BSF  PORTB,4

VOLTA
SWAPF STATUS_TEMP,W
MOVWF STATUS
SWAPF W_TEMP,F
SWAPF W_TEMP,W

BCF  INTCON,2
RETFIE
 
INICIO
BANK1      ;ALTERA PARA BANCO 1
...
MOVLW B'00000111'    ; CONFIGURA OPTION REG
MOVWF OPTION_REG
MOVLW B'10100000'    
MOVWF INTCON   ; HABILITA A INTERRUPÇÃO DO TIMER0
BANK0  
MOVLW .217
MOVWF TMR0
LOOP
GOTO LOOP
END